// Copyright 2021 Manna Harbour
// https://github.com/manna-harbour/miryoku

#include <dt-bindings/zmk/keys.h>
#include <dt-bindings/zmk/bt.h>
#include <dt-bindings/zmk/outputs.h>

#include "../miryoku/custom_config.h"
#include "../miryoku/mapping/42/uninarf.h"
#include "../miryoku/miryoku.dtsi"
